## linux/drivers/gpu/drm/panel/Kconfig.cut
```kconfig
config DRM_PANEL_CHIPONE_ICNL9916_720_1600
	tristate "Chipone ICNL9916 720x1600 panel"
	depends on OF
	depends on DRM_MIPI_DSI
	depends on BACKLIGHT_CLASS_DEVICE
	help
	  Say Y here if you want to enable support for the Chipone ICNL9916
	  MIPI-DSI video mode panel with a resolution of 720x1600.
	  This type of panel is mainly found on mobile phones.

config DRM_PANEL_NOVATEK_NT36672C_1080_2408
	tristate "NOVATEK NT36672C 1080x2408 panel"
	depends on OF
	depends on DRM_MIPI_DSI
	depends on BACKLIGHT_CLASS_DEVICE
	help
	  Say Y here if you want to enable support for the NOVATEK NT36672C
	  MIPI-DSI video mode panel with a resolution of 1080x2408.
	  This type of panel is mainly found on mobile phones.

config DRM_PANEL_EBBG_FT8719
	tristate "EBBG FT8719 panel driver"
	depends on OF
```

## linux/drivers/input/touchscreen/Kconfig.cut
```kconfig
config TOUCHSCREEN_IMAGIS
	tristate "Imagis touchscreen support"
	depends on I2C
	help
	  Say Y here if you have an Imagis IST30xxC touchscreen.
	  If unsure, say N.

	  To compile this driver as a module, choose M here: the
	  module will be called imagis.

config TOUCHSCREEN_NT36XXX_SPI
	tristate "Novatek NT36XXX In-Cell SPI touchscreen controller"
	depends on SPI_MASTER
	select REGMAP
        help
          Say Y here if you have a Novatek NT36xxx series In-Cell
          touchscreen connected to your system over SPI.

          If unsure, say N.

          To compile this driver as a module, choose M here: the
          module will be called nt36xxx_ts_spi.

config TOUCHSCREEN_IMX6UL_TSC
	tristate "Freescale i.MX6UL touchscreen controller"
	depends on ((OF && GPIOLIB) || COMPILE_TEST) && HAS_IOMEM
	help
	  Say Y here if you have a Freescale i.MX6UL, and want to
	  use the internal touchscreen controller.

	  If unsure, say N.

	  To compile this driver as a module, choose M here: the
	  module will be called imx6ul_tsc.
```
